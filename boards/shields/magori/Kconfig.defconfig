## boards/shields/magori/Kconfig.defconfig
```kconfig
if SHIELD_MAGORI_RIGHT

# Name must be less than 16 characters long!
config ZMK_KEYBOARD_NAME
    default "Magori KBD"

config ZMK_SPLIT_ROLE_CENTRAL
    default y

endif

if SHIELD_MAGORI_LEFT || SHIELD_MAGORI_RIGHT

config ZMK_SPLIT
    default y

endif
```

## boards/shields/magori/Kconfig.shield
```kconfig
# No whitespace after the comma or in your part name!
config SHIELD_MAGORI_LEFT
    def_bool $(shields_list_contains,magori_left)

# No whitespace after the comma or in your part name!
config SHIELD_MAGORI_RIGHT
    def_bool $(shields_list_contains,magori_right)
```
